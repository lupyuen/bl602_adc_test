## Kconfig
```kconfig
#
# For a description of the syntax of this configuration file,
# see the file kconfig-language.txt in the NuttX tools repository.
#

config EXAMPLES_BL602_ADC_TEST
	tristate "BL602 ADC Test App"
	default n
	---help---
		Enable the BL602 ADC Test App

if EXAMPLES_BL602_ADC_TEST

config EXAMPLES_BL602_ADC_TEST_PROGNAME
	string "Program name"
	default "bl602_adc_test"
	---help---
		This is the name of the program that will be used when the NSH ELF
		program is installed.

config EXAMPLES_BL602_ADC_TEST_PRIORITY
	int "BL602 ADC Test task priority"
	default 100

config EXAMPLES_BL602_ADC_TEST_STACKSIZE
	int "BL602 ADC Test stack size"
	default DEFAULT_TASK_STACKSIZE

endif
```
